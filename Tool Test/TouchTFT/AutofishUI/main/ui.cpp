#include "ui.h"

// [BEGIN lopaka generated bitmaps]
static const unsigned char PROGMEM image_btn_icon_bits[] = {
    0x0f,0xff,0xff,0xff,0xff,0xff,0x00,0x00,0x0f,0xff,0xff,0xff,0xff,0xff,0x00,0x00,
    0x0c,0x00,0x00,0x00,0x00,0x03,0x00,0x00,0x0c,0x00,0x00,0x00,0x00,0x03,0x00,0x00,
    0x0c,0x00,0x00,0x00,0x00,0x03,0x00,0x00,0x0c,0x00,0x00,0x00,0x00,0x03,0x00,0x00,
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    0x00,0x00,0x3f,0xff,0xc0,0xf0,0xf0,0x00,0x00,0x00,0x3f,0xff,0xc0,0xf0,0xf0,0x00
};

static const unsigned char PROGMEM image_clock_alarm_icon1_bits[] = {
    0x3f,0xc3,0x0f,0xf0,0x3f,0xc3,0x0f,0xf0,0xcf,0x0f,0xc3,0xcc,0xcf,0x0f,0xc3,0xcc,
    0xfc,0xf3,0x3c,0xfc,0xfc,0xf3,0x3c,0xfc,0xf3,0x00,0x03,0x3c,0xf3,0x00,0x03,0x3c,
    0xcc,0x00,0x00,0xcc,0xcc,0x00,0x00,0xcc,0x30,0x03,0x00,0x30,0x30,0x03,0x00,0x30,
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    0x0c,0xf3,0x3c,0xc0,0x0c,0xf3,0x3c,0xc0,0x30,0x0f,0xc0,0x30,0x30,0x0f,0xc0,0x30
};

static const unsigned char PROGMEM image_Connected_bits[] = {
    0x00,0x0e,0x00,0x0e,0x00,0x0e,0x00,0x0e,0x00,0xee,0x00,0xee,0x00,0xee,0x00,0xee,
    0x0e,0xee,0x0e,0xee,0x0e,0xee,0x0e,0xee,0xee,0xee,0xee,0xee,0xee,0xee,0x00,0x00
};

static const unsigned char PROGMEM image_Disconnected_bits[] = {
    0x82,0x0e,0x44,0x0a,0x28,0x0a,0x10,0x0a,0x28,0xea,0x44,0xaa,0x82,0xaa,0x00,0xaa,
    0x0e,0xaa,0x0a,0xaa,0x0a,0xaa,0x0a,0xaa,0xea,0xaa,0xaa,0xaa,0xee,0xee,0x00,0x00
};

static const unsigned char PROGMEM image_project_icon_bits[] = {
    0x00,0x00,0x00,0x00,0x00,0x00,0x00,0x00,0x00,0x00,0x00,0x00,0x00,0x00,0x00,0x00,
    0x00,0x00,0x00,0x00,0x00,0x00,0x00,0x00,0x00,0x00,0x00,0x00,0x00,0x03,0xf0,0x00,
    0x00,0x0f,0xfe,0x00,0x00,0x3f,0xff,0x00,0x60,0xfc,0x3f,0x80,0x71,0xf0,0x3b,0xc0,
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    0x00,0x00,0x00,0x00,0x00,0x00,0x00,0x00
};
// [END lopaka generated bitmaps]

// สีที่ใช้ในธีม AutoFISH
#define BG_COLOR         0x0841  // สีพื้นหลังเข้ม
#define PANEL_COLOR      0x4208  // สีกรอบ Panel
#define TEXT_WHITE       0xFFFF
#define TEXT_YELLOW      0xFC00
#define TEXT_ORANGE      0xF880
#define TEXT_RED         0xF800
#define TEXT_GREEN       0x07E0
#define LINE_COLOR       0xBDF7
#define FOOD_BG_COLOR    0x43E9
#define BTN_IDLE_COLOR   0xFC00
#define BTN_PRESS_COLOR  0xFD28

// State Cache เพื่อป้องกันการสั่งวาดซ้ำเด็ดขาด (Zero-Flicker Architecture)
static char s_prevTime[10] = "";
static int  s_prevWifi = -1;
static char s_prevT1Text[16] = "";
static char s_prevT2Text[16] = "";
static int  s_prevT1Toggle = -1;
static int  s_prevT2Toggle = -1;
static int  s_prevPercent = -1;
static char s_prevLog1[32] = "";
static char s_prevLog2[32] = "";
static int  s_prevBtnPressed = -1;

void ui_init_draw(void) {
    auto& tft = getTft();
    tft.startWrite();
    tft.fillScreen(0x0000);

    // วาดพื้นหลังหลัก
    tft.fillRect(0, 0, 240, 320, BG_COLOR);

    // ส่วนหัว: Icon โครงการ และ ชื่อ
    tft.drawBitmap(17, 27, image_project_icon_bits, 30, 30, TEXT_WHITE);
    tft.setTextColor(TEXT_WHITE, BG_COLOR);
    tft.setTextSize(2);
    tft.drawString("AutoFISH", 53, 34);

    // 1. Panel TIMER
    tft.fillRoundRect(13, 60, 216, 98, 6, PANEL_COLOR);
    tft.drawRoundRect(13, 60, 216, 98, 6, LINE_COLOR);
    tft.setTextColor(TEXT_WHITE, PANEL_COLOR);
    tft.setTextSize(1);
    tft.drawString("TIMER", 20, 66);

    tft.drawBitmap(18, 86, image_clock_alarm_icon1_bits, 30, 32, TEXT_WHITE);
    tft.drawBitmap(18, 123, image_clock_alarm_icon1_bits, 30, 32, TEXT_WHITE);
    tft.drawLine(17, 120, 221, 120, LINE_COLOR);

    // 2. Panel FOOD LEVEL
    tft.fillRoundRect(13, 163, 106, 97, 6, PANEL_COLOR);
    tft.drawRoundRect(13, 163, 106, 97, 6, LINE_COLOR);
    tft.setTextColor(TEXT_WHITE, PANEL_COLOR);
    tft.setTextSize(1);
    tft.drawString("Level", 19, 168);
    tft.drawRect(19, 186, 25, 68, LINE_COLOR);

    tft.setTextColor(TEXT_YELLOW, PANEL_COLOR);
    tft.setTextSize(1);
    tft.drawString("Remaining:", 48, 188);

    // 3. Panel LOG
    tft.fillRoundRect(123, 163, 106, 97, 6, PANEL_COLOR);
    tft.drawRoundRect(123, 163, 106, 97, 6, LINE_COLOR);
    tft.setTextColor(TEXT_WHITE, PANEL_COLOR);
    tft.setTextSize(1);
    tft.drawString("Log", 129, 168);

    // รีเซ็ต Cache
    s_prevTime[0] = '\0';
    s_prevWifi = -1;
    s_prevT1Text[0] = '\0';
    s_prevT2Text[0] = '\0';
    s_prevT1Toggle = -1;
    s_prevT2Toggle = -1;
    s_prevPercent = -1;
    s_prevLog1[0] = '\0';
    s_prevLog2[0] = '\0';
    s_prevBtnPressed = -1;

    tft.endWrite();

    ui_draw_feed_button(false);
}

void ui_draw_header(const char* timeStr, bool wifiConnected) {
    int curWifi = wifiConnected ? 1 : 0;
    bool needUpdateWifi = (curWifi != s_prevWifi);
    bool needUpdateTime = (strcmp(timeStr, s_prevTime) != 0);

    if (!needUpdateWifi && !needUpdateTime) return;

    auto& tft = getTft();
    tft.startWrite();

    if (needUpdateWifi) {
        s_prevWifi = curWifi;
        tft.fillRect(145, 5, 20, 18, BG_COLOR);
        if (wifiConnected) {
            tft.drawBitmap(149, 6, image_Connected_bits, 15, 16, TEXT_GREEN);
        } else {
            tft.drawBitmap(149, 6, image_Disconnected_bits, 15, 16, TEXT_RED);
        }
    }

    if (needUpdateTime) {
        strncpy(s_prevTime, timeStr, sizeof(s_prevTime) - 1);
        tft.setTextPadding(65);
        tft.setTextColor(TEXT_WHITE, BG_COLOR);
        tft.setTextSize(2);
        tft.drawString(timeStr, 174, 6);
        tft.setTextPadding(0);
    }

    tft.endWrite();
}

void ui_set_timer1_text(const char* timeStr) {
    if (strcmp(timeStr, s_prevT1Text) == 0) return;
    strncpy(s_prevT1Text, timeStr, sizeof(s_prevT1Text) - 1);

    auto& tft = getTft();
    tft.startWrite();
    tft.setTextPadding(115);
    tft.setTextColor(TEXT_WHITE, PANEL_COLOR);
    tft.setTextSize(2);
    tft.drawString(timeStr, 54, 94);
    tft.setTextPadding(0);
    tft.endWrite();
}

void ui_set_timer2_text(const char* timeStr) {
    if (strcmp(timeStr, s_prevT2Text) == 0) return;
    strncpy(s_prevT2Text, timeStr, sizeof(s_prevT2Text) - 1);

    auto& tft = getTft();
    tft.startWrite();
    tft.setTextPadding(115);
    tft.setTextColor(TEXT_WHITE, PANEL_COLOR);
    tft.setTextSize(2);
    tft.drawString(timeStr, 54, 131);
    tft.setTextPadding(0);
    tft.endWrite();
}

void ui_draw_timer1_toggle(bool isOn) {
    int cur = isOn ? 1 : 0;
    if (cur == s_prevT1Toggle) return;
    s_prevT1Toggle = cur;

    auto& tft = getTft();
    tft.startWrite();
    tft.fillRoundRect(173, 92, 48, 22, 4, isOn ? TEXT_GREEN : TEXT_ORANGE);
    tft.drawRoundRect(173, 92, 48, 22, 4, TEXT_WHITE);

    if (isOn) {
        tft.fillRoundRect(196, 93, 23, 20, 3, TEXT_WHITE);
        tft.setTextColor(0x0000, TEXT_WHITE);
        tft.setTextSize(1);
        tft.drawString("ON", 200, 99);
    } else {
        tft.fillRoundRect(174, 93, 23, 20, 3, TEXT_WHITE);
        tft.setTextColor(0x0000, TEXT_WHITE);
        tft.setTextSize(1);
        tft.drawString("OFF", 176, 99);
    }
    tft.endWrite();
}

void ui_draw_timer2_toggle(bool isOn) {
    int cur = isOn ? 1 : 0;
    if (cur == s_prevT2Toggle) return;
    s_prevT2Toggle = cur;

    auto& tft = getTft();
    tft.startWrite();
    tft.fillRoundRect(173, 129, 48, 22, 4, isOn ? TEXT_GREEN : TEXT_ORANGE);
    tft.drawRoundRect(173, 129, 48, 22, 4, TEXT_WHITE);

    if (isOn) {
        tft.fillRoundRect(196, 130, 23, 20, 3, TEXT_WHITE);
        tft.setTextColor(0x0000, TEXT_WHITE);
        tft.setTextSize(1);
        tft.drawString("ON", 200, 136);
    } else {
        tft.fillRoundRect(174, 130, 23, 20, 3, TEXT_WHITE);
        tft.setTextColor(0x0000, TEXT_WHITE);
        tft.setTextSize(1);
        tft.drawString("OFF", 176, 136);
    }
    tft.endWrite();
}

// วาดหลอดอาหารแบบ Flicker-Free ไม่มีการเคลียร์จอก่อน ทุกพิกเซลระบายรอบเดียว
void ui_draw_food_level(int percent) {
    if (percent < 0) percent = 0;
    if (percent > 100) percent = 100;
    if (percent == s_prevPercent) return;
    s_prevPercent = percent;

    auto& tft = getTft();
    tft.startWrite();

    // วาดหลอดอาหาร: เติมช่องว่างด้านบน และเติมอาหารด้านล่าง
    int fillH = (68 * percent) / 100;
    int emptyH = 68 - fillH;

    if (emptyH > 0) {
        tft.fillRect(19, 186, 25, emptyH, FOOD_BG_COLOR);
    }
    if (fillH > 0) {
        uint16_t fillColor = (percent <= 20) ? TEXT_RED : ((percent <= 50) ? TEXT_YELLOW : TEXT_GREEN);
        tft.fillRect(19, 186 + emptyH, 25, fillH, fillColor);
    }
    tft.drawRect(19, 186, 25, 68, LINE_COLOR);

    // ตัวเลขเปอร์เซ็นต์
    tft.setTextPadding(68);
    tft.setTextColor((percent <= 20) ? TEXT_RED : TEXT_WHITE, PANEL_COLOR);
    tft.setTextSize(2);
    char buf[16];
    snprintf(buf, sizeof(buf), "%d %%", percent);
    tft.drawString(buf, 48, 206);
    tft.setTextPadding(0);

    tft.endWrite();
}

void ui_draw_logs(const char* log1, const char* log2) {
    if (strcmp(log1, s_prevLog1) == 0 && strcmp(log2, s_prevLog2) == 0) return;
    strncpy(s_prevLog1, log1, sizeof(s_prevLog1) - 1);
    strncpy(s_prevLog2, log2, sizeof(s_prevLog2) - 1);

    auto& tft = getTft();
    tft.startWrite();

    tft.setTextColor(TEXT_WHITE, PANEL_COLOR);
    tft.setTextSize(1);
    tft.drawString("1:", 127, 188);

    tft.setTextPadding(82);
    tft.setTextColor(TEXT_YELLOW, PANEL_COLOR);
    tft.drawString(log1, 139, 188);

    tft.setTextColor(TEXT_WHITE, PANEL_COLOR);
    tft.drawString("2:", 127, 212);

    tft.setTextColor(TEXT_YELLOW, PANEL_COLOR);
    tft.drawString(log2, 139, 212);
    tft.setTextPadding(0);

    tft.endWrite();
}

void ui_draw_feed_button(bool pressed) {
    int cur = pressed ? 1 : 0;
    if (cur == s_prevBtnPressed) return;
    s_prevBtnPressed = cur;

    auto& tft = getTft();
    tft.startWrite();
    uint16_t btnColor = pressed ? BTN_PRESS_COLOR : BTN_IDLE_COLOR;

    tft.fillCircle(120, 276, 32, btnColor);
    tft.drawCircle(120, 276, 32, TEXT_WHITE);
    tft.drawCircle(120, 276, 33, 0x0000);

    tft.drawBitmap(90, 246, image_btn_icon_bits, 60, 60, TEXT_WHITE);
    tft.endWrite();
}

bool is_touch_feed_btn(uint16_t x, uint16_t y) {
    int dx = (int)x - 120;
    int dy = (int)y - 276;
    return (dx * dx + dy * dy) <= (36 * 36);
}

bool is_touch_toggle1(uint16_t x, uint16_t y) {
    return (x >= 165 && x <= 228 && y >= 85 && y <= 118);
}

bool is_touch_toggle2(uint16_t x, uint16_t y) {
    return (x >= 165 && x <= 228 && y >= 122 && y <= 155);
}
